## firmware/main/Kconfig.projbuild
```kconfig
menu "NexAlert Project Configuration"

config NEXALERT_NODE_ID
    string "Node ID"
    default "node-001"
    help
        Unique identifier for this node

endmenu
```

## firmware/sdkconfig.defaults
```kconfig
# NexAlert ESP32-S3 Configuration
CONFIG_IDF_TARGET="esp32s3"
CONFIG_ESPTOOLPY_FLASHSIZE_8MB=y
CONFIG_PARTITION_TABLE_CUSTOM=y
CONFIG_PARTITION_TABLE_CUSTOM_FILENAME="partitions.csv"

# Wi-Fi
CONFIG_ESP_WIFI_STATIC_RX_BUFFER_NUM=10
CONFIG_ESP_WIFI_DYNAMIC_RX_BUFFER_NUM=32

# FreeRTOS
CONFIG_FREERTOS_HZ=1000
CONFIG_FREERTOS_UNICORE=n

# Logging
CONFIG_LOG_DEFAULT_LEVEL_INFO=y

# NVS
CONFIG_NVS_ENCRYPTION=y
```
